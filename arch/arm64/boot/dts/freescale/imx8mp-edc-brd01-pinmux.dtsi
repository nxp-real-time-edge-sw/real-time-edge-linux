/***********************************************************************************************************************
 * This file was generated by the MCUXpresso Config Tools. Any manual edits made to this file
 * will be overwritten if the respective MCUXpresso Config Tools is used to update this file.
 **********************************************************************************************************************/

/*
 * TEXT BELOW IS USED AS SETTING FOR TOOLS *************************************
!!GlobalInfo
product: Pins v16.0
processor: MIMX8ML8xxxLZ
package_id: MIMX8ML8DVNLZ
mcu_data: ksdk2_0
processor_version: 16.3.0
external_user_signals: {}
 * BE CAREFUL MODIFYING THIS COMMENT - IT IS YAML SETTINGS FOR TOOLS ***********
 */

&iomuxc {
    pinctrl-names = "default_iomuxc";
    pinctrl-0 = <&BOARD_InitPins>;


    imx8mp-custom-board {
        BOARD_InitPins: BOARD_InitPinsgrp {                /*!< Function assigned for the core: Cortex-A53[a53_0] */
/*
 * TEXT BELOW IS USED AS SETTING FOR TOOLS *************************************
BOARD_InitPins:
- options: {callFromInitBoot: 'false', coreID: a53_0}
- pin_list:
  - {pin_num: AH28, peripheral: ENET_QOS, signal: enet_qos_mdc, pin_signal: ENET_MDC}
  - {pin_num: AH29, peripheral: ENET_QOS, signal: enet_qos_mdio, pin_signal: ENET_MDIO}
  - {pin_num: AG29, peripheral: ENET_QOS, signal: 'enet_qos_rgmii_rd, 0', pin_signal: ENET_RD0}
  - {pin_num: AG28, peripheral: ENET_QOS, signal: 'enet_qos_rgmii_rd, 1', pin_signal: ENET_RD1}
  - {pin_num: AF29, peripheral: ENET_QOS, signal: 'enet_qos_rgmii_rd, 2', pin_signal: ENET_RD2}
  - {pin_num: AF28, peripheral: ENET_QOS, signal: 'enet_qos_rgmii_rd, 3', pin_signal: ENET_RD3}
  - {pin_num: AE28, peripheral: ENET_QOS, signal: enet_qos_rgmii_rx_ctl, pin_signal: ENET_RX_CTL}
  - {pin_num: AE29, peripheral: ENET_QOS, signal: enet_qos_rgmii_rxc, pin_signal: ENET_RXC}
  - {pin_num: AC25, peripheral: ENET_QOS, signal: 'enet_qos_rgmii_td, 0', pin_signal: ENET_TD0}
  - {pin_num: AE26, peripheral: ENET_QOS, signal: 'enet_qos_rgmii_td, 1', pin_signal: ENET_TD1}
  - {pin_num: AF26, peripheral: ENET_QOS, signal: 'enet_qos_rgmii_td, 2', pin_signal: ENET_TD2}
  - {pin_num: AF24, peripheral: ENET_QOS, signal: enet_qos_rgmii_tx_ctl, pin_signal: ENET_TX_CTL}
  - {pin_num: AE24, peripheral: ENET_QOS, signal: enet_qos_rgmii_txc, pin_signal: ENET_TXC}
  - {pin_num: AE12, peripheral: SAI1, signal: sai_mclk, pin_signal: SAI1_MCLK}
  - {pin_num: AH8, peripheral: SAI1, signal: sai_rx_bclk, pin_signal: SAI1_RXC}
  - {pin_num: AC10, peripheral: SAI1, signal: 'sai_rx_data, 0', pin_signal: SAI1_RXD0}
  - {pin_num: AF10, peripheral: SAI1, signal: 'sai_rx_data, 1', pin_signal: SAI1_RXD1}
  - {pin_num: AH9, peripheral: SAI1, signal: 'sai_rx_data, 2', pin_signal: SAI1_RXD2}
  - {pin_num: AJ9, peripheral: SAI1, signal: sai_rx_sync, pin_signal: SAI1_RXFS}
  - {pin_num: AJ11, peripheral: SAI1, signal: 'sai_tx_data, 0', pin_signal: SAI1_TXD0}
  - {pin_num: AJ10, peripheral: SAI1, signal: 'sai_tx_data, 1', pin_signal: SAI1_TXD1}
  - {pin_num: AH11, peripheral: SAI1, signal: 'sai_tx_data, 2', pin_signal: SAI1_TXD2}
  - {pin_num: AD12, peripheral: SAI1, signal: 'sai_tx_data, 3', pin_signal: SAI1_TXD3}
  - {pin_num: AH13, peripheral: SAI1, signal: 'sai_tx_data, 4', pin_signal: SAI1_TXD4}
  - {pin_num: AH14, peripheral: SAI1, signal: 'sai_tx_data, 5', pin_signal: SAI1_TXD5}
  - {pin_num: AC12, peripheral: SAI1, signal: 'sai_tx_data, 6', pin_signal: SAI1_TXD6}
  - {pin_num: AJ13, peripheral: SAI1, signal: 'sai_tx_data, 7', pin_signal: SAI1_TXD7}
  - {pin_num: AF12, peripheral: SAI1, signal: sai_tx_sync, pin_signal: SAI1_TXFS}
  - {pin_num: AJ15, peripheral: SAI2, signal: sai_mclk, pin_signal: SAI2_MCLK}
  - {pin_num: AH16, peripheral: SAI2, signal: 'sai_tx_data, 0', pin_signal: SAI2_TXD0}
  - {pin_num: AJ17, peripheral: SAI2, signal: sai_tx_sync, pin_signal: SAI2_TXFS}
  - {pin_num: AH19, peripheral: SAI2, signal: 'sai_tx_data, 2', pin_signal: SAI3_TXC}
  - {pin_num: AH18, peripheral: SAI2, signal: 'sai_tx_data, 3', pin_signal: SAI3_TXD}
  - {pin_num: AJ20, peripheral: SAI5, signal: sai_mclk, pin_signal: SAI3_MCLK}
  - {pin_num: AH20, peripheral: SAI7, signal: sai_mclk, pin_signal: ECSPI2_MISO}
  - {pin_num: AH21, peripheral: SAI7, signal: sai_tx_bclk, pin_signal: ECSPI2_SCLK}
  - {pin_num: AJ21, peripheral: SAI7, signal: 'sai_tx_data, 0', pin_signal: ECSPI2_MOSI}
  - {pin_num: AE20, peripheral: SAI7, signal: sai_tx_sync, pin_signal: ECSPI1_SS0}
  - {pin_num: G25, peripheral: XTALOSC, signal: xtalosc_xtal_in_24m, pin_signal: XTALI_24M}
  - {pin_num: G26, peripheral: XTALOSC, signal: xtalosc_xtal_out_24m, pin_signal: XTALO_24M}
  - {pin_num: AC8, peripheral: I2C1, signal: i2c_scl, pin_signal: I2C1_SCL}
  - {pin_num: AH7, peripheral: I2C1, signal: i2c_sda, pin_signal: I2C1_SDA}
  - {pin_num: AJ7, peripheral: I2C3, signal: i2c_scl, pin_signal: I2C3_SCL}
  - {pin_num: AJ6, peripheral: I2C3, signal: i2c_sda, pin_signal: I2C3_SDA}
  - {pin_num: AF8, peripheral: I2C4, signal: i2c_scl, pin_signal: I2C4_SCL}
  - {pin_num: AJ22, peripheral: I2C4, signal: i2c_sda, pin_signal: ECSPI2_SS0}
  - {pin_num: E10, peripheral: USB1, signal: usb_d_n, pin_signal: USB1_D_N}
  - {pin_num: D10, peripheral: USB1, signal: usb_d_p, pin_signal: USB1_D_P}
  - {pin_num: F10, peripheral: USB1, signal: usb_resref, pin_signal: USB1_TXRTUNE}
  - {pin_num: B9, peripheral: USB1, signal: usb_rx_n, pin_signal: USB1_RX_N}
  - {pin_num: A9, peripheral: USB1, signal: usb_rx_p, pin_signal: USB1_RX_P}
  - {pin_num: B10, peripheral: USB1, signal: usb_tx_n, pin_signal: USB1_TX_N}
  - {pin_num: A10, peripheral: USB1, signal: usb_tx_p, pin_signal: USB1_TX_P}
  - {pin_num: A11, peripheral: USB1, signal: usb_vbus, pin_signal: USB1_VBUS}
  - {pin_num: A5, peripheral: USB1, signal: usb_pwr, pin_signal: GPIO1_IO12}
  - {pin_num: AD18, peripheral: PWM2, signal: pwm_out, pin_signal: SPDIF_RX}
  - {pin_num: J6, peripheral: DRAM, signal: 'dram_ac, 00', pin_signal: DRAM_AC00}
  - {pin_num: G5, peripheral: DRAM, signal: 'dram_ac, 01', pin_signal: DRAM_AC01}
  - {pin_num: N6, peripheral: DRAM, signal: 'dram_ac, 02', pin_signal: DRAM_AC02}
  - {pin_num: J4, peripheral: DRAM, signal: 'dram_ac, 03', pin_signal: DRAM_AC03}
  - {pin_num: M1, peripheral: DRAM, signal: 'dram_ac, 04', pin_signal: DRAM_AC04}
  - {pin_num: M2, peripheral: DRAM, signal: 'dram_ac, 05', pin_signal: DRAM_AC05}
  - {pin_num: G4, peripheral: DRAM, signal: 'dram_ac, 06', pin_signal: DRAM_AC06}
  - {pin_num: J5, peripheral: DRAM, signal: 'dram_ac, 07', pin_signal: DRAM_AC07}
  - {pin_num: L6, peripheral: DRAM, signal: 'dram_ac, 08', pin_signal: DRAM_AC08}
  - {pin_num: L4, peripheral: DRAM, signal: 'dram_ac, 09', pin_signal: DRAM_AC09}
  - {pin_num: E4, peripheral: DRAM, signal: 'dram_ac, 10', pin_signal: DRAM_AC10}
  - {pin_num: D4, peripheral: DRAM, signal: 'dram_ac, 11', pin_signal: DRAM_AC11}
  - {pin_num: N4, peripheral: DRAM, signal: 'dram_ac, 12', pin_signal: DRAM_AC12}
  - {pin_num: N5, peripheral: DRAM, signal: 'dram_ac, 13', pin_signal: DRAM_AC13}
  - {pin_num: L5, peripheral: DRAM, signal: 'dram_ac, 14', pin_signal: DRAM_AC14}
  - {pin_num: R5, peripheral: DRAM, signal: 'dram_ac, 15', pin_signal: DRAM_AC15}
  - {pin_num: N1, peripheral: DRAM, signal: 'dram_ac, 16', pin_signal: DRAM_AC16}
  - {pin_num: N2, peripheral: DRAM, signal: 'dram_ac, 17', pin_signal: DRAM_AC17}
  - {pin_num: P2, peripheral: DRAM, signal: 'dram_ac, 19', pin_signal: DRAM_AC19}
  - {pin_num: AA4, peripheral: DRAM, signal: 'dram_ac, 20', pin_signal: DRAM_AC20}
  - {pin_num: AA5, peripheral: DRAM, signal: 'dram_ac, 21', pin_signal: DRAM_AC21}
  - {pin_num: AA6, peripheral: DRAM, signal: 'dram_ac, 22', pin_signal: DRAM_AC22}
  - {pin_num: U4, peripheral: DRAM, signal: 'dram_ac, 23', pin_signal: DRAM_AC23}
  - {pin_num: V2, peripheral: DRAM, signal: 'dram_ac, 24', pin_signal: DRAM_AC24}
  - {pin_num: V1, peripheral: DRAM, signal: 'dram_ac, 25', pin_signal: DRAM_AC25}
  - {pin_num: P1, peripheral: DRAM, signal: 'dram_ac, 26', pin_signal: DRAM_AC26}
  - {pin_num: R4, peripheral: DRAM, signal: 'dram_ac, 27', pin_signal: DRAM_AC27}
  - {pin_num: W4, peripheral: DRAM, signal: 'dram_ac, 28', pin_signal: DRAM_AC28}
  - {pin_num: W5, peripheral: DRAM, signal: 'dram_ac, 29', pin_signal: DRAM_AC29}
  - {pin_num: AE4, peripheral: DRAM, signal: 'dram_ac, 30', pin_signal: DRAM_AC30}
  - {pin_num: AF4, peripheral: DRAM, signal: 'dram_ac, 31', pin_signal: DRAM_AC31}
  - {pin_num: U5, peripheral: DRAM, signal: 'dram_ac, 32', pin_signal: DRAM_AC32}
  - {pin_num: U6, peripheral: DRAM, signal: 'dram_ac, 33', pin_signal: DRAM_AC33}
  - {pin_num: U1, peripheral: DRAM, signal: 'dram_ac, 34', pin_signal: DRAM_AC34}
  - {pin_num: U2, peripheral: DRAM, signal: 'dram_ac, 35', pin_signal: DRAM_AC35}
  - {pin_num: W6, peripheral: DRAM, signal: 'dram_ac, 36', pin_signal: DRAM_AC36}
  - {pin_num: AC4, peripheral: DRAM, signal: 'dram_ac, 37', pin_signal: DRAM_AC37}
  - {pin_num: AC5, peripheral: DRAM, signal: 'dram_ac, 38', pin_signal: DRAM_AC38}
  - {pin_num: T2, peripheral: DRAM, signal: dram_alert_n, pin_signal: DRAM_ALERT_N}
  - {pin_num: B2, peripheral: DRAM, signal: 'dram_dm, 0', pin_signal: DRAM_DM0}
  - {pin_num: H2, peripheral: DRAM, signal: 'dram_dm, 1', pin_signal: DRAM_DM1}
  - {pin_num: AB2, peripheral: DRAM, signal: 'dram_dm, 2', pin_signal: DRAM_DM2}
  - {pin_num: AH2, peripheral: DRAM, signal: 'dram_dm, 3', pin_signal: DRAM_DM3}
  - {pin_num: B3, peripheral: DRAM, signal: 'dram_dq, 00', pin_signal: DRAM_DQ00}
  - {pin_num: A2, peripheral: DRAM, signal: 'dram_dq, 01', pin_signal: DRAM_DQ01}
  - {pin_num: E1, peripheral: DRAM, signal: 'dram_dq, 02', pin_signal: DRAM_DQ02}
  - {pin_num: F2, peripheral: DRAM, signal: 'dram_dq, 03', pin_signal: DRAM_DQ03}
  - {pin_num: E2, peripheral: DRAM, signal: 'dram_dq, 04', pin_signal: DRAM_DQ04}
  - {pin_num: C1, peripheral: DRAM, signal: 'dram_dq, 05', pin_signal: DRAM_DQ05}
  - {pin_num: C2, peripheral: DRAM, signal: 'dram_dq, 06', pin_signal: DRAM_DQ06}
  - {pin_num: B1, peripheral: DRAM, signal: 'dram_dq, 07', pin_signal: DRAM_DQ07}
  - {pin_num: G1, peripheral: DRAM, signal: 'dram_dq, 08', pin_signal: DRAM_DQ08}
  - {pin_num: H1, peripheral: DRAM, signal: 'dram_dq, 09', pin_signal: DRAM_DQ09}
  - {pin_num: K1, peripheral: DRAM, signal: 'dram_dq, 10', pin_signal: DRAM_DQ10}
  - {pin_num: K2, peripheral: DRAM, signal: 'dram_dq, 11', pin_signal: DRAM_DQ11}
  - {pin_num: L2, peripheral: DRAM, signal: 'dram_dq, 12', pin_signal: DRAM_DQ12}
  - {pin_num: L1, peripheral: DRAM, signal: 'dram_dq, 13', pin_signal: DRAM_DQ13}
  - {pin_num: G2, peripheral: DRAM, signal: 'dram_dq, 14', pin_signal: DRAM_DQ14}
  - {pin_num: F1, peripheral: DRAM, signal: 'dram_dq, 15', pin_signal: DRAM_DQ15}
  - {pin_num: AC1, peripheral: DRAM, signal: 'dram_dq, 16', pin_signal: DRAM_DQ16}
  - {pin_num: AB1, peripheral: DRAM, signal: 'dram_dq, 17', pin_signal: DRAM_DQ17}
  - {pin_num: W2, peripheral: DRAM, signal: 'dram_dq, 18', pin_signal: DRAM_DQ18}
  - {pin_num: Y2, peripheral: DRAM, signal: 'dram_dq, 19', pin_signal: DRAM_DQ19}
  - {pin_num: Y1, peripheral: DRAM, signal: 'dram_dq, 20', pin_signal: DRAM_DQ20}
  - {pin_num: W1, peripheral: DRAM, signal: 'dram_dq, 21', pin_signal: DRAM_DQ21}
  - {pin_num: AC2, peripheral: DRAM, signal: 'dram_dq, 22', pin_signal: DRAM_DQ22}
  - {pin_num: AD1, peripheral: DRAM, signal: 'dram_dq, 23', pin_signal: DRAM_DQ23}
  - {pin_num: AH3, peripheral: DRAM, signal: 'dram_dq, 24', pin_signal: DRAM_DQ24}
  - {pin_num: AJ2, peripheral: DRAM, signal: 'dram_dq, 25', pin_signal: DRAM_DQ25}
  - {pin_num: AE1, peripheral: DRAM, signal: 'dram_dq, 26', pin_signal: DRAM_DQ26}
  - {pin_num: AD2, peripheral: DRAM, signal: 'dram_dq, 27', pin_signal: DRAM_DQ27}
  - {pin_num: AE2, peripheral: DRAM, signal: 'dram_dq, 28', pin_signal: DRAM_DQ28}
  - {pin_num: AG1, peripheral: DRAM, signal: 'dram_dq, 29', pin_signal: DRAM_DQ29}
  - {pin_num: AG2, peripheral: DRAM, signal: 'dram_dq, 30', pin_signal: DRAM_DQ30}
  - {pin_num: AH1, peripheral: DRAM, signal: 'dram_dq, 31', pin_signal: DRAM_DQ31}
  - {pin_num: D1, peripheral: DRAM, signal: dram_dqs0_n, pin_signal: DRAM_DQS0_N}
  - {pin_num: D2, peripheral: DRAM, signal: dram_dqs0_p, pin_signal: DRAM_DQS0_P}
  - {pin_num: J1, peripheral: DRAM, signal: dram_dqs1_n, pin_signal: DRAM_DQS1_N}
  - {pin_num: J2, peripheral: DRAM, signal: dram_dqs1_p, pin_signal: DRAM_DQS1_P}
  - {pin_num: AA1, peripheral: DRAM, signal: dram_dqs2_n, pin_signal: DRAM_DQS2_N}
  - {pin_num: AA2, peripheral: DRAM, signal: dram_dqs2_p, pin_signal: DRAM_DQS2_P}
  - {pin_num: AF1, peripheral: DRAM, signal: dram_dqs3_n, pin_signal: DRAM_DQS3_N}
  - {pin_num: AF2, peripheral: DRAM, signal: dram_dqs3_p, pin_signal: DRAM_DQS3_P}
  - {pin_num: T1, peripheral: DRAM, signal: dram_reset_n, pin_signal: DRAM_RESET_N}
  - {pin_num: R2, peripheral: DRAM, signal: dram_vref, pin_signal: DRAM_VREF}
  - {pin_num: R1, peripheral: DRAM, signal: dram_zn, pin_signal: DRAM_ZN}
  - {pin_num: AD24, peripheral: ENET_QOS, signal: 'enet_qos_rgmii_td, 3', pin_signal: ENET_TD3}
  - {pin_num: AJ28, peripheral: HDMI, signal: hdmi_rext, pin_signal: HDMI_REXT}
  - {pin_num: AJ25, peripheral: HDMI, signal: hdmi_tx0_n, pin_signal: HDMI_TX0_N}
  - {pin_num: AH25, peripheral: HDMI, signal: hdmi_tx0_p, pin_signal: HDMI_TX0_P}
  - {pin_num: AJ26, peripheral: HDMI, signal: hdmi_tx1_n, pin_signal: HDMI_TX1_N}
  - {pin_num: AH26, peripheral: HDMI, signal: hdmi_tx1_p, pin_signal: HDMI_TX1_P}
  - {pin_num: AJ27, peripheral: HDMI, signal: hdmi_tx2_n, pin_signal: HDMI_TX2_N}
  - {pin_num: AH27, peripheral: HDMI, signal: hdmi_tx2_p, pin_signal: HDMI_TX2_P}
  - {pin_num: AJ24, peripheral: HDMI, signal: hdmi_txc_n, pin_signal: HDMI_TXC_N}
  - {pin_num: AH24, peripheral: HDMI, signal: hdmi_txc_p, pin_signal: HDMI_TXC_P}
  - {pin_num: AD22, peripheral: HDMI, signal: hdmi_cec, pin_signal: HDMI_CEC}
  - {pin_num: AE22, peripheral: HDMI, signal: hdmi_hpd, pin_signal: HDMI_HPD}
  - {pin_num: AC22, peripheral: HDMI, signal: hdmi_scl, pin_signal: HDMI_DDC_SCL}
  - {pin_num: AF22, peripheral: HDMI, signal: hdmi_sda, pin_signal: HDMI_DDC_SDA}
  - {pin_num: E16, peripheral: PCIE1, signal: pcie_ref_pad_clk_n, pin_signal: PCIE_REF_PAD_CLK_N}
  - {pin_num: D16, peripheral: PCIE1, signal: pcie_ref_pad_clk_p, pin_signal: PCIE_REF_PAD_CLK_P}
  - {pin_num: F16, peripheral: PCIE1, signal: pcie_resref, pin_signal: PCIE_RESREF}
  - {pin_num: B14, peripheral: PCIE1, signal: pcie_rxn_n, pin_signal: PCIE_RXN_N}
  - {pin_num: A14, peripheral: PCIE1, signal: pcie_rxn_p, pin_signal: PCIE_RXN_P}
  - {pin_num: B15, peripheral: PCIE1, signal: pcie_txn_n, pin_signal: PCIE_TXN_N}
  - {pin_num: A15, peripheral: PCIE1, signal: pcie_txn_p, pin_signal: PCIE_TXN_P}
  - {pin_num: AJ5, peripheral: PCIE1, signal: pcie_clkreq_b, pin_signal: UART4_RXD}
  - {pin_num: AH12, peripheral: SAI6, signal: sai_mclk, pin_signal: SAI1_RXD7}
  - {pin_num: AE10, peripheral: SAI6, signal: 'sai_tx_data, 0', pin_signal: SAI1_RXD5}
  - {pin_num: AH10, peripheral: SAI6, signal: sai_tx_sync, pin_signal: SAI1_RXD6}
  - {pin_num: B6, peripheral: WDOG1, signal: wdog_wdog_b, pin_signal: GPIO1_IO02}
  - {pin_num: R26, peripheral: SAI3, signal: sai_mclk, pin_signal: NAND_DQS}
  - {pin_num: N25, peripheral: SAI3, signal: sai_tx_bclk, pin_signal: NAND_ALE}
  - {pin_num: AE6, peripheral: UART3, signal: uart_rx, pin_signal: UART3_RXD}
  - {pin_num: L26, peripheral: SAI3, signal: 'sai_tx_data, 0', pin_signal: NAND_CE0_B}
  - {pin_num: AJ4, peripheral: UART3, signal: uart_tx, pin_signal: UART3_TXD}
  - {pin_num: L25, peripheral: SAI3, signal: sai_tx_sync, pin_signal: NAND_DATA01}
  - {pin_num: AC16, peripheral: SAI3, signal: 'sai_tx_data, 1', pin_signal: SAI3_TXFS}
  - {pin_num: AC20, peripheral: SAI7, signal: sai_rx_bclk, pin_signal: ECSPI1_MOSI}
  - {pin_num: AD20, peripheral: SAI7, signal: 'sai_rx_data, 0', pin_signal: ECSPI1_MISO}
  - {pin_num: AF20, peripheral: SAI7, signal: sai_rx_sync, pin_signal: ECSPI1_SCLK}
  - {pin_num: AJ18, peripheral: SAI2, signal: 'sai_rx_data, 2', pin_signal: SAI3_RXC}
  - {pin_num: AF18, peripheral: SAI2, signal: 'sai_rx_data, 3', pin_signal: SAI3_RXD}
  - {pin_num: AJ8, peripheral: SAI1, signal: 'sai_rx_data, 3', pin_signal: SAI1_RXD3}
  - {pin_num: R25, peripheral: SAI3, signal: 'sai_rx_data, 0', pin_signal: NAND_DATA00}
  - {pin_num: AD6, peripheral: UART1, signal: uart_rx, pin_signal: UART1_RXD}
  - {pin_num: AJ3, peripheral: UART1, signal: uart_tx, pin_signal: UART1_TXD}
  - {pin_num: Y29, peripheral: UART1, signal: uart_cts_b, pin_signal: SD1_DATA0}
  - {pin_num: Y28, peripheral: UART1, signal: uart_rts_b, pin_signal: SD1_DATA1}
  - {pin_num: U26, peripheral: UART2, signal: uart_cts_b, pin_signal: SD1_DATA4}
  - {pin_num: AA29, peripheral: UART2, signal: uart_rts_b, pin_signal: SD1_DATA5}
  - {pin_num: V29, peripheral: UART2, signal: uart_rx, pin_signal: SD1_DATA2}
  - {pin_num: V28, peripheral: UART2, signal: uart_tx, pin_signal: SD1_DATA3}
  - {pin_num: W26, peripheral: UART3, signal: uart_cts_b, pin_signal: SD1_STROBE}
  - {pin_num: W25, peripheral: UART3, signal: uart_rts_b, pin_signal: SD1_RESET_B}
  - {pin_num: A7, peripheral: GPIO1, signal: 'gpio_io, 00', pin_signal: GPIO1_IO00}
  - {pin_num: D6, peripheral: GPIO1, signal: 'gpio_io, 03', pin_signal: GPIO1_IO03}
  - {pin_num: B4, peripheral: GPIO1, signal: 'gpio_io, 05', pin_signal: GPIO1_IO05}
  - {pin_num: A3, peripheral: GPIO1, signal: 'gpio_io, 06', pin_signal: GPIO1_IO06}
  - {pin_num: F6, peripheral: GPIO1, signal: 'gpio_io, 07', pin_signal: GPIO1_IO07}
  - {pin_num: W28, peripheral: GPIO2, signal: 'gpio_io, 00', pin_signal: SD1_CLK}
  - {pin_num: W29, peripheral: GPIO2, signal: 'gpio_io, 01', pin_signal: SD1_CMD}
  - {pin_num: AA28, peripheral: I2C2, signal: i2c_scl, pin_signal: SD1_DATA6}
  - {pin_num: U25, peripheral: I2C2, signal: i2c_sda, pin_signal: SD1_DATA7}
  - {pin_num: AD16, peripheral: SAI5, signal: sai_tx_sync, pin_signal: SAI5_RXD1}
  - {pin_num: AD10, peripheral: SAI6, signal: sai_tx_bclk, pin_signal: SAI1_RXD4}
  - {pin_num: AH15, peripheral: SAI2, signal: sai_tx_bclk, pin_signal: SAI2_TXC}
  - {pin_num: AJ16, peripheral: SAI2, signal: sai_rx_bclk, pin_signal: SAI2_RXC}
  - {pin_num: AF16, peripheral: SAI5, signal: sai_tx_bclk, pin_signal: SAI5_RXD2}
  - {pin_num: AH17, peripheral: SAI5, signal: 'sai_tx_data, 1', pin_signal: SAI2_RXFS}
  - {pin_num: AJ14, peripheral: SAI2, signal: 'sai_tx_data, 1', pin_signal: SAI2_RXD0}
  - {pin_num: AJ19, peripheral: SAI2, signal: 'sai_rx_data, 1', pin_signal: SAI3_RXFS}
  - {pin_num: AD29, peripheral: USDHC2, signal: usdhc_cd_b, pin_signal: SD2_CD_B}
  - {pin_num: AB29, peripheral: USDHC2, signal: usdhc_clk, pin_signal: SD2_CLK}
  - {pin_num: AB28, peripheral: USDHC2, signal: usdhc_cmd, pin_signal: SD2_CMD}
  - {pin_num: AC28, peripheral: USDHC2, signal: 'usdhc_data, 0', pin_signal: SD2_DATA0}
  - {pin_num: AC29, peripheral: USDHC2, signal: 'usdhc_data, 1', pin_signal: SD2_DATA1}
  - {pin_num: AA26, peripheral: USDHC2, signal: 'usdhc_data, 2', pin_signal: SD2_DATA2}
  - {pin_num: AA25, peripheral: USDHC2, signal: 'usdhc_data, 3', pin_signal: SD2_DATA3}
  - {pin_num: AD28, peripheral: USDHC2, signal: usdhc_reset_b, pin_signal: SD2_RESET_B}
  - {pin_num: E6, peripheral: USDHC2, signal: usdhc_vselect, pin_signal: GPIO1_IO04}
  - {pin_num: AC26, peripheral: USDHC2, signal: usdhc_wp, pin_signal: SD2_WP}
  - {pin_num: B5, peripheral: GPIO1, signal: 'gpio_io, 15', pin_signal: GPIO1_IO15}
  - {pin_num: A4, peripheral: GPIO1, signal: 'gpio_io, 14', pin_signal: GPIO1_IO14}
  - {pin_num: U28, peripheral: USDHC3, signal: usdhc_clk, pin_signal: NAND_WE_B}
  - {pin_num: U29, peripheral: USDHC3, signal: usdhc_cmd, pin_signal: NAND_WP_B}
  - {pin_num: P29, peripheral: USDHC3, signal: 'usdhc_data, 0', pin_signal: NAND_DATA04}
  - {pin_num: N29, peripheral: USDHC3, signal: 'usdhc_data, 1', pin_signal: NAND_DATA05}
  - {pin_num: M29, peripheral: USDHC3, signal: 'usdhc_data, 2', pin_signal: NAND_DATA06}
  - {pin_num: R29, peripheral: USDHC3, signal: 'usdhc_data, 3', pin_signal: NAND_DATA07}
  - {pin_num: R28, peripheral: USDHC3, signal: 'usdhc_data, 4', pin_signal: NAND_RE_B}
  - {pin_num: P28, peripheral: USDHC3, signal: 'usdhc_data, 5', pin_signal: NAND_CE2_B}
  - {pin_num: N28, peripheral: USDHC3, signal: 'usdhc_data, 6', pin_signal: NAND_CE3_B}
  - {pin_num: M28, peripheral: USDHC3, signal: 'usdhc_data, 7', pin_signal: NAND_CLE}
  - {pin_num: T28, peripheral: GPIO3, signal: 'gpio_io, 16', pin_signal: NAND_READY_B}
  - {pin_num: T29, peripheral: USDHC3, signal: usdhc_strobe, pin_signal: NAND_CE1_B}
  - {pin_num: N24, peripheral: USDHC3, signal: usdhc_wp, pin_signal: NAND_DATA03}
  - {pin_num: A8, peripheral: GPIO1, signal: 'gpio_io, 08', pin_signal: GPIO1_IO08, PUE: Weak_Pull_Up}
  - {pin_num: E8, peripheral: GPIO1, signal: 'gpio_io, 01', pin_signal: GPIO1_IO01}
  - {pin_num: E14, peripheral: USB2, signal: usb_d_n, pin_signal: USB2_D_N}
  - {pin_num: D14, peripheral: USB2, signal: usb_d_p, pin_signal: USB2_D_P}
  - {pin_num: AH23, peripheral: EARC, signal: earc_aux, pin_signal: EARC_AUX}
  - {pin_num: AH22, peripheral: EARC, signal: earc_n_hpd, pin_signal: EARC_N_HPD}
  - {pin_num: AJ23, peripheral: EARC, signal: earc_p_util, pin_signal: EARC_P_UTIL}
  - {pin_num: G10, peripheral: SRC, signal: 'src_boot_mode, 0', pin_signal: BOOT_MODE0}
  - {pin_num: B11, peripheral: USB1, signal: usb_id, pin_signal: USB1_ID}
  - {pin_num: G20, peripheral: JTAG, signal: jtag_mode, pin_signal: JTAG_MOD}
  - {pin_num: G18, peripheral: JTAG, signal: jtag_tck, pin_signal: JTAG_TCK}
  - {pin_num: G16, peripheral: JTAG, signal: jtag_tdi, pin_signal: JTAG_TDI}
  - {pin_num: F14, peripheral: JTAG, signal: jtag_tdo, pin_signal: JTAG_TDO}
  - {pin_num: G14, peripheral: JTAG, signal: jtag_tms, pin_signal: JTAG_TMS}
  - {pin_num: J24, peripheral: CCM, signal: ccm_pmic_stby_req, pin_signal: PMIC_STBY_REQ}
  - {pin_num: J25, peripheral: SNVS, signal: snvs_rtc, pin_signal: RTC_XTALI}
  - {pin_num: J29, peripheral: SNVS, signal: snvs_por_b, pin_signal: POR_B}
  - {pin_num: G22, peripheral: SNVS, signal: snvs_onoff, pin_signal: ONOFF}
  - {pin_num: A6, peripheral: GPIO1, signal: 'gpio_io, 13', pin_signal: GPIO1_IO13}
  - {pin_num: B7, peripheral: GPIO1, signal: 'gpio_io, 10', pin_signal: GPIO1_IO10}
  - {pin_num: G12, peripheral: SRC, signal: 'src_boot_mode, 3', pin_signal: BOOT_MODE3}
  - {pin_num: AE16, peripheral: SAI5, signal: 'sai_rx_data, 0', pin_signal: SAI5_RXD0}
  - {pin_num: AJ12, peripheral: SAI1, signal: sai_tx_bclk, pin_signal: SAI1_TXC}
  - {pin_num: AE18, peripheral: SPDIF1, signal: spdif_out, pin_signal: SPDIF_TX}
  - {pin_num: AC18, peripheral: SPDIF1, signal: spdif_ext_clk, pin_signal: SPDIF_EXT_CLK}
  - {pin_num: AF14, peripheral: GPIO3, signal: 'gpio_io, 25', pin_signal: SAI5_MCLK}
  - {pin_num: AD14, peripheral: SAI5, signal: sai_rx_bclk, pin_signal: SAI5_RXC}
  - {pin_num: AC14, peripheral: SAI5, signal: sai_rx_sync, pin_signal: SAI5_RXFS}
  - {pin_num: B8, peripheral: GPIO1, signal: 'gpio_io, 09', pin_signal: GPIO1_IO09}
  - {pin_num: AE14, peripheral: SAI5, signal: 'sai_tx_data, 0', pin_signal: SAI5_RXD3}
  - {pin_num: D8, peripheral: GPIO1, signal: 'gpio_io, 11', pin_signal: GPIO1_IO11}
  - {pin_num: L24, peripheral: GPIO3, signal: 'gpio_io, 08', pin_signal: NAND_DATA02}
 * BE CAREFUL MODIFYING THIS COMMENT - IT IS YAML SETTINGS FOR TOOLS ***********
 */
            fsl,pins = <
                MX8MP_IOMUXC_ECSPI1_MISO__AUDIOMIX_SAI7_RX_DATA00 0x00000106
                MX8MP_IOMUXC_ECSPI1_MOSI__AUDIOMIX_SAI7_RX_BCLK 0x00000106
                MX8MP_IOMUXC_ECSPI1_SCLK__AUDIOMIX_SAI7_RX_SYNC 0x00000106
                MX8MP_IOMUXC_ECSPI1_SS0__AUDIOMIX_SAI7_TX_SYNC 0x00000106
                MX8MP_IOMUXC_ECSPI2_MISO__AUDIOMIX_SAI7_MCLK 0x00000106
                MX8MP_IOMUXC_ECSPI2_MOSI__AUDIOMIX_SAI7_TX_DATA00 0x00000106
                MX8MP_IOMUXC_ECSPI2_SCLK__AUDIOMIX_SAI7_TX_BCLK 0x00000106
                MX8MP_IOMUXC_ECSPI2_SS0__I2C4_SDA          0x00000106
                MX8MP_IOMUXC_ENET_MDC__ENET_QOS_MDC        0x00000106
                MX8MP_IOMUXC_ENET_MDIO__ENET_QOS_MDIO      0x00000106
                MX8MP_IOMUXC_ENET_RD0__ENET_QOS_RGMII_RD0  0x00000106
                MX8MP_IOMUXC_ENET_RD1__ENET_QOS_RGMII_RD1  0x00000106
                MX8MP_IOMUXC_ENET_RD2__ENET_QOS_RGMII_RD2  0x00000106
                MX8MP_IOMUXC_ENET_RD3__ENET_QOS_RGMII_RD3  0x00000106
                MX8MP_IOMUXC_ENET_RXC__CCM_ENET_QOS_CLOCK_GENERATE_RX_CLK 0x00000106
                MX8MP_IOMUXC_ENET_RX_CTL__ENET_QOS_RGMII_RX_CTL 0x00000106
                MX8MP_IOMUXC_ENET_TD0__ENET_QOS_RGMII_TD0  0x00000106
                MX8MP_IOMUXC_ENET_TD1__ENET_QOS_RGMII_TD1  0x00000106
                MX8MP_IOMUXC_ENET_TD2__ENET_QOS_RGMII_TD2  0x00000106
                MX8MP_IOMUXC_ENET_TD3__ENET_QOS_RGMII_TD3  0x00000106
                MX8MP_IOMUXC_ENET_TXC__CCM_ENET_QOS_CLOCK_GENERATE_TX_CLK 0x00000106
                MX8MP_IOMUXC_ENET_TX_CTL__ENET_QOS_RGMII_TX_CTL 0x00000106
                MX8MP_IOMUXC_GPIO1_IO00__GPIO1_IO00        0x00000106
                MX8MP_IOMUXC_GPIO1_IO01__GPIO1_IO01        0x00000106
                MX8MP_IOMUXC_GPIO1_IO02__WDOG1_WDOG_B      0x00000146
                MX8MP_IOMUXC_GPIO1_IO03__GPIO1_IO03        0x00000106
                MX8MP_IOMUXC_GPIO1_IO04__USDHC2_VSELECT    0x00000106
                MX8MP_IOMUXC_GPIO1_IO05__GPIO1_IO05        0x00000146
                MX8MP_IOMUXC_GPIO1_IO06__GPIO1_IO06        0x00000106
                MX8MP_IOMUXC_GPIO1_IO07__GPIO1_IO07        0x00000106
                MX8MP_IOMUXC_GPIO1_IO08__GPIO1_IO08        0x00000146
                MX8MP_IOMUXC_GPIO1_IO09__GPIO1_IO09        0x00000106
                MX8MP_IOMUXC_GPIO1_IO10__GPIO1_IO10        0x00000106
                MX8MP_IOMUXC_GPIO1_IO11__GPIO1_IO11        0x00000106
                MX8MP_IOMUXC_GPIO1_IO12__USB1_PWR          0x00000106
                MX8MP_IOMUXC_GPIO1_IO13__GPIO1_IO13        0x00000106
                MX8MP_IOMUXC_GPIO1_IO14__GPIO1_IO14        0x00000106
                MX8MP_IOMUXC_GPIO1_IO15__GPIO1_IO15        0x00000106
                MX8MP_IOMUXC_HDMI_CEC__HDMIMIX_HDMI_CEC    0x00000106
                MX8MP_IOMUXC_HDMI_DDC_SCL__HDMIMIX_HDMI_SCL 0x00000106
                MX8MP_IOMUXC_HDMI_DDC_SDA__HDMIMIX_HDMI_SDA 0x00000106
                MX8MP_IOMUXC_HDMI_HPD__HDMIMIX_HDMI_HPD    0x00000106
                MX8MP_IOMUXC_I2C1_SCL__I2C1_SCL            0x00000106
                MX8MP_IOMUXC_I2C1_SDA__I2C1_SDA            0x00000106
                MX8MP_IOMUXC_I2C3_SCL__I2C3_SCL            0x00000106
                MX8MP_IOMUXC_I2C3_SDA__I2C3_SDA            0x00000106
                MX8MP_IOMUXC_I2C4_SCL__I2C4_SCL            0x00000106
                MX8MP_IOMUXC_NAND_ALE__AUDIOMIX_SAI3_TX_BCLK 0x00000106
                MX8MP_IOMUXC_NAND_CE0_B__AUDIOMIX_SAI3_TX_DATA00 0x00000106
                MX8MP_IOMUXC_NAND_CE1_B__USDHC3_STROBE     0x00000106
                MX8MP_IOMUXC_NAND_CE2_B__USDHC3_DATA5      0x00000106
                MX8MP_IOMUXC_NAND_CE3_B__USDHC3_DATA6      0x00000106
                MX8MP_IOMUXC_NAND_CLE__USDHC3_DATA7        0x00000106
                MX8MP_IOMUXC_NAND_DATA00__AUDIOMIX_SAI3_RX_DATA00 0x00000106
                MX8MP_IOMUXC_NAND_DATA01__AUDIOMIX_SAI3_TX_SYNC 0x00000106
                MX8MP_IOMUXC_NAND_DATA02__GPIO3_IO08       0x00000106
                MX8MP_IOMUXC_NAND_DATA03__USDHC3_WP        0x00000106
                MX8MP_IOMUXC_NAND_DATA04__USDHC3_DATA0     0x00000106
                MX8MP_IOMUXC_NAND_DATA05__USDHC3_DATA1     0x00000106
                MX8MP_IOMUXC_NAND_DATA06__USDHC3_DATA2     0x00000106
                MX8MP_IOMUXC_NAND_DATA07__USDHC3_DATA3     0x00000106
                MX8MP_IOMUXC_NAND_DQS__AUDIOMIX_SAI3_MCLK  0x00000106
                MX8MP_IOMUXC_NAND_READY_B__GPIO3_IO16      0x00000106
                MX8MP_IOMUXC_NAND_RE_B__USDHC3_DATA4       0x00000106
                MX8MP_IOMUXC_NAND_WE_B__USDHC3_CLK         0x00000106
                MX8MP_IOMUXC_NAND_WP_B__USDHC3_CMD         0x00000106
                MX8MP_IOMUXC_SAI1_MCLK__AUDIOMIX_SAI1_MCLK 0x00000106
                MX8MP_IOMUXC_SAI1_RXC__AUDIOMIX_SAI1_RX_BCLK 0x00000106
                MX8MP_IOMUXC_SAI1_RXD0__AUDIOMIX_SAI1_RX_DATA00 0x00000106
                MX8MP_IOMUXC_SAI1_RXD1__AUDIOMIX_SAI1_RX_DATA01 0x00000106
                MX8MP_IOMUXC_SAI1_RXD2__AUDIOMIX_SAI1_RX_DATA02 0x00000106
                MX8MP_IOMUXC_SAI1_RXD3__AUDIOMIX_SAI1_RX_DATA03 0x00000106
                MX8MP_IOMUXC_SAI1_RXD4__AUDIOMIX_SAI6_TX_BCLK 0x00000106
                MX8MP_IOMUXC_SAI1_RXD5__AUDIOMIX_SAI6_TX_DATA00 0x00000106
                MX8MP_IOMUXC_SAI1_RXD6__AUDIOMIX_SAI6_TX_SYNC 0x00000106
                MX8MP_IOMUXC_SAI1_RXD7__AUDIOMIX_SAI6_MCLK 0x00000106
                MX8MP_IOMUXC_SAI1_RXFS__AUDIOMIX_SAI1_RX_SYNC 0x00000106
                MX8MP_IOMUXC_SAI1_TXC__AUDIOMIX_SAI1_TX_BCLK 0x00000106
                MX8MP_IOMUXC_SAI1_TXD0__AUDIOMIX_SAI1_TX_DATA00 0x00000106
                MX8MP_IOMUXC_SAI1_TXD1__AUDIOMIX_SAI1_TX_DATA01 0x00000106
                MX8MP_IOMUXC_SAI1_TXD2__AUDIOMIX_SAI1_TX_DATA02 0x00000106
                MX8MP_IOMUXC_SAI1_TXD3__AUDIOMIX_SAI1_TX_DATA03 0x00000106
                MX8MP_IOMUXC_SAI1_TXD4__AUDIOMIX_SAI1_TX_DATA04 0x00000106
                MX8MP_IOMUXC_SAI1_TXD5__AUDIOMIX_SAI1_TX_DATA05 0x00000106
                MX8MP_IOMUXC_SAI1_TXD6__AUDIOMIX_SAI1_TX_DATA06 0x00000106
                MX8MP_IOMUXC_SAI1_TXD7__AUDIOMIX_SAI1_TX_DATA07 0x00000106
                MX8MP_IOMUXC_SAI1_TXFS__AUDIOMIX_SAI1_TX_SYNC 0x00000106
                MX8MP_IOMUXC_SAI2_MCLK__AUDIOMIX_SAI2_MCLK 0x00000106
                MX8MP_IOMUXC_SAI2_RXC__AUDIOMIX_SAI2_RX_BCLK 0x00000106
                MX8MP_IOMUXC_SAI2_RXD0__AUDIOMIX_SAI2_TX_DATA01 0x00000106
                MX8MP_IOMUXC_SAI2_RXFS__AUDIOMIX_SAI5_TX_DATA01 0x00000106
                MX8MP_IOMUXC_SAI2_TXC__AUDIOMIX_SAI2_TX_BCLK 0x00000106
                MX8MP_IOMUXC_SAI2_TXD0__AUDIOMIX_SAI2_TX_DATA00 0x00000106
                MX8MP_IOMUXC_SAI2_TXFS__AUDIOMIX_SAI2_TX_SYNC 0x00000106
                MX8MP_IOMUXC_SAI3_MCLK__AUDIOMIX_SAI5_MCLK 0x00000106
                MX8MP_IOMUXC_SAI3_RXC__AUDIOMIX_SAI2_RX_DATA02 0x00000106
                MX8MP_IOMUXC_SAI3_RXD__AUDIOMIX_SAI2_RX_DATA03 0x00000106
                MX8MP_IOMUXC_SAI3_RXFS__AUDIOMIX_SAI2_RX_DATA01 0x00000106
                MX8MP_IOMUXC_SAI3_TXC__AUDIOMIX_SAI2_TX_DATA02 0x00000106
                MX8MP_IOMUXC_SAI3_TXD__AUDIOMIX_SAI2_TX_DATA03 0x00000106
                MX8MP_IOMUXC_SAI3_TXFS__AUDIOMIX_SAI3_TX_DATA01 0x00000106
                MX8MP_IOMUXC_SAI5_MCLK__GPIO3_IO25         0x00000106
                MX8MP_IOMUXC_SAI5_RXC__AUDIOMIX_SAI5_RX_BCLK 0x00000106
                MX8MP_IOMUXC_SAI5_RXD0__AUDIOMIX_SAI5_RX_DATA00 0x00000106
                MX8MP_IOMUXC_SAI5_RXD1__AUDIOMIX_SAI5_TX_SYNC 0x00000106
                MX8MP_IOMUXC_SAI5_RXD2__AUDIOMIX_SAI5_TX_BCLK 0x00000106
                MX8MP_IOMUXC_SAI5_RXD3__AUDIOMIX_SAI5_TX_DATA00 0x00000106
                MX8MP_IOMUXC_SAI5_RXFS__AUDIOMIX_SAI5_RX_SYNC 0x00000106
                MX8MP_IOMUXC_SD1_CLK__GPIO2_IO00           0x00000106
                MX8MP_IOMUXC_SD1_CMD__GPIO2_IO01           0x00000106
                MX8MP_IOMUXC_SD1_DATA0__UART1_DTE_CTS      0x00000106
                MX8MP_IOMUXC_SD1_DATA1__UART1_DTE_RTS      0x00000106
                MX8MP_IOMUXC_SD1_DATA2__UART2_DTE_RX       0x00000106
                MX8MP_IOMUXC_SD1_DATA3__UART2_DTE_TX       0x00000106
                MX8MP_IOMUXC_SD1_DATA4__UART2_DTE_CTS      0x00000106
                MX8MP_IOMUXC_SD1_DATA5__UART2_DTE_RTS      0x00000106
                MX8MP_IOMUXC_SD1_DATA6__I2C2_SCL           0x00000106
                MX8MP_IOMUXC_SD1_DATA7__I2C2_SDA           0x00000106
                MX8MP_IOMUXC_SD1_RESET_B__UART3_DCE_RTS    0x00000106
                MX8MP_IOMUXC_SD1_STROBE__UART3_DCE_CTS     0x00000106
                MX8MP_IOMUXC_SD2_CD_B__USDHC2_CD_B         0x00000106
                MX8MP_IOMUXC_SD2_CLK__USDHC2_CLK           0x00000106
                MX8MP_IOMUXC_SD2_CMD__USDHC2_CMD           0x00000106
                MX8MP_IOMUXC_SD2_DATA0__USDHC2_DATA0       0x00000106
                MX8MP_IOMUXC_SD2_DATA1__USDHC2_DATA1       0x00000106
                MX8MP_IOMUXC_SD2_DATA2__USDHC2_DATA2       0x00000106
                MX8MP_IOMUXC_SD2_DATA3__USDHC2_DATA3       0x00000106
                MX8MP_IOMUXC_SD2_RESET_B__USDHC2_RESET_B   0x00000106
                MX8MP_IOMUXC_SD2_WP__USDHC2_WP             0x00000106
                MX8MP_IOMUXC_SPDIF_EXT_CLK__AUDIOMIX_SPDIF1_EXT_CLK 0x00000106
                MX8MP_IOMUXC_SPDIF_RX__PWM2_OUT            0x00000106
                MX8MP_IOMUXC_SPDIF_TX__AUDIOMIX_SPDIF1_OUT 0x00000106
                MX8MP_IOMUXC_UART1_RXD__UART1_DCE_RX       0x00000106
                MX8MP_IOMUXC_UART1_TXD__UART1_DCE_TX       0x00000106
                MX8MP_IOMUXC_UART3_RXD__UART3_DCE_RX       0x00000106
                MX8MP_IOMUXC_UART3_TXD__UART3_DCE_TX       0x00000106
                MX8MP_IOMUXC_UART4_RXD__PCIE_CLKREQ_B      0x00000106

            >;
        };
    };
};

/***********************************************************************************************************************
 * EOF
 **********************************************************************************************************************/

