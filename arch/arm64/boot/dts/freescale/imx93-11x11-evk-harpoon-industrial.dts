// SPDX-License-Identifier: (GPL-2.0+ OR MIT)
/*
 * Copyright 2023, 2026 NXP
 */

#include "imx93-11x11-evk-root.dts"

&eqos {
	status = "disabled";
};

&flexcan2 {
	status = "disabled";
};

&reg_can2_standby {
	status = "disabled";
};
