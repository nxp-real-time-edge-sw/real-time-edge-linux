## drivers/net/dsa/netc/Kconfig
```kconfig
# SPDX-License-Identifier: GPL-2.0-only

config NET_DSA_NETC
	tristate "NXP NETC Ethernet switch family support"
	depends on NET_DSA && SPI
	select NET_DSA_TAG_NETC
	help
	  This is the driver for the NXP ENTC Ethernet switch family.
	  These are managed over an SPI interface. Probing is handled
	  based on OF bindings and so is the linkage to PHYLINK.

config NET_DSA_NETC_PTP
	bool "Support for the PTP clock on the NXP NETC Ethernet switch"
	depends on NET_DSA_NETC
	depends on PTP_1588_CLOCK
	help
	  This enables support for timestamping and PTP clock manipulations in
	  the NETC DSA driver.
```
